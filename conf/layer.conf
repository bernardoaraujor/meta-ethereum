## conf/layer.conf
```bitbake
# We have a conf and classes directory, add to BBPATH
BBPATH .= ":${LAYERDIR}"

# We have recipes-* directories, add to BBFILES
BBFILES += "${LAYERDIR}/recipes-*/*/*.bb \
            ${LAYERDIR}/recipes-*/*/*.bbappend"

BBFILE_COLLECTIONS += "meta-ethereum"
BBFILE_PATTERN_meta-ethereum = "^${LAYERDIR}/"
BBFILE_PRIORITY_meta-ethereum = "6"

LAYERDEPENDS_meta-ethereum = "core rust-layer nim-layer"
LAYERSERIES_COMPAT_meta-ethereum = "hardknott"
```
